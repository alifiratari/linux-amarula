## Documentation/devicetree/bindings/display/panel/techstar,ts8550b.txt
```
Techstar TS8550B MIPI DSI LCD Panel

Required properties:
- compatible: must be "techstar,ts8550b"
- reg: DSI virtual channel used by that screen
- avdd-supply: analog regulator dc1 switch
- dvdd-supply: 3v3 digital regulator
- reset-gpios: a GPIO phandle for the reset pin

Optional properties:
- backlight: phandle for the backlight control.

panel@0 {
	compatible = "techstar,ts8550b";
	reg = <0>;
	avdd-supply = <&reg_dc1sw>;
	dvdd-supply = <&reg_dldo2>;
	reset-gpios = <&pio 3 24 GPIO_ACTIVE_HIGH>; /* PD24 */
	backlight = <&backlight>;
};
```

## Documentation/devicetree/bindings/iio/light/ltr501.txt
```
LTR507 - ALS, Ambient light sensor

Required properties:
- compatible: Must be one of:
	"liteon,ltr507"
- reg: the I2C address of the sensor
```

## drivers/media/platform/sunxi/sun4i-csi/Kconfig
```kconfig
config VIDEO_SUN4I_CSI
	tristate "Allwinner A10 CMOS Sensor Interface Support"
	depends on VIDEO_DEV && VIDEO_V4L2 && HAS_DMA
	depends on ARCH_SUNXI || COMPILE_TEST
	select VIDEOBUF2_DMA_CONTIG
	select V4L2_FWNODE
	select V4L2_MEM2MEM_DEV
	help
	  This is a V4L2 driver for the Allwinner A10 CSI

	  To compile this driver as a module, choose M here: the module
	  will be called sun4i_csi.
```
